## CMakeLists.txt
```
cmake_minimum_required(VERSION 3.20.0)
find_package(Zephyr REQUIRED HINTS $ENV{ZEPHYR_BASE})
project(hello_world)
include("${CMAKE_CURRENT_SOURCE_DIR}/../../cmake/das_firmware.cmake")
das_zephyr_app(src/main.das src/main.cpp)
```

## prj.conf
```kconfig
CONFIG_SERIAL=y
CONFIG_CONSOLE=y
CONFIG_UART_CONSOLE=y
CONFIG_GPIO=y
CONFIG_INPUT=y
CONFIG_INPUT_THREAD_STACK_SIZE=2048
CONFIG_CPP=y
CONFIG_STD_CPP17=y
CONFIG_REQUIRES_FULL_LIBCPP=y
CONFIG_MAIN_STACK_SIZE=8192
CONFIG_HEAP_MEM_POOL_SIZE=16384
```

## src/main.cpp
```c
#include <zephyr/kernel.h>
#include <zephyr/sys/printk.h>
#include "daScript/nano_print.h"
#include "main.das.h"

static void board_print(const char *text) {
	printk("%s", text ? text : "");
}

int main(void) {
	das::das_nano_set_print(&board_print);
	das::main::Standalone ctx;
	das::main::g_ctx = &ctx;  // aot_driver always emits this
	ctx.main();
	k_sleep(K_FOREVER);
	return 0;
}
```
