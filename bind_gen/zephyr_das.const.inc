// generated from bind_gen/headers.txt — do not edit
#ifdef K_HIGHEST_THREAD_PRIO
addConstant<uint32_t>(*this, "K_HIGHEST_THREAD_PRIO", (uint32_t)(K_HIGHEST_THREAD_PRIO));
#endif
#ifdef K_HIGHEST_APPLICATION_THREAD_PRIO
addConstant<uint32_t>(*this, "K_HIGHEST_APPLICATION_THREAD_PRIO", (uint32_t)(K_HIGHEST_APPLICATION_THREAD_PRIO));
#endif
#ifdef K_LOWEST_APPLICATION_THREAD_PRIO
addConstant<uint32_t>(*this, "K_LOWEST_APPLICATION_THREAD_PRIO", (uint32_t)(K_LOWEST_APPLICATION_THREAD_PRIO));
#endif
#ifdef K_ESSENTIAL
addConstant<uint32_t>(*this, "K_ESSENTIAL", (uint32_t)(K_ESSENTIAL));
#endif
#ifdef K_FP_REGS
addConstant<uint32_t>(*this, "K_FP_REGS", (uint32_t)(K_FP_REGS));
#endif
#ifdef K_USER
addConstant<uint32_t>(*this, "K_USER", (uint32_t)(K_USER));
#endif
#ifdef K_INHERIT_PERMS
addConstant<uint32_t>(*this, "K_INHERIT_PERMS", (uint32_t)(K_INHERIT_PERMS));
#endif
#ifdef K_CALLBACK_STATE
addConstant<uint32_t>(*this, "K_CALLBACK_STATE", (uint32_t)(K_CALLBACK_STATE));
#endif
#ifdef K_DSP_REGS
addConstant<uint32_t>(*this, "K_DSP_REGS", (uint32_t)(K_DSP_REGS));
#endif
#ifdef K_AGU_REGS
addConstant<uint32_t>(*this, "K_AGU_REGS", (uint32_t)(K_AGU_REGS));
#endif
#ifdef K_SSE_REGS
addConstant<uint32_t>(*this, "K_SSE_REGS", (uint32_t)(K_SSE_REGS));
#endif
#ifdef K_STACK_FLAG_ALLOC
addConstant<uint32_t>(*this, "K_STACK_FLAG_ALLOC", (uint32_t)(K_STACK_FLAG_ALLOC));
#endif
#ifdef K_MSGQ_FLAG_ALLOC
addConstant<uint32_t>(*this, "K_MSGQ_FLAG_ALLOC", (uint32_t)(K_MSGQ_FLAG_ALLOC));
#endif
#ifdef Z_HEAP_MIN_SIZE
addConstant<uint32_t>(*this, "Z_HEAP_MIN_SIZE", (uint32_t)(Z_HEAP_MIN_SIZE));
#endif
#ifdef K_POLL_TYPE_SIGNAL
addConstant<uint32_t>(*this, "K_POLL_TYPE_SIGNAL", (uint32_t)(K_POLL_TYPE_SIGNAL));
#endif
#ifdef K_POLL_TYPE_SEM_AVAILABLE
addConstant<uint32_t>(*this, "K_POLL_TYPE_SEM_AVAILABLE", (uint32_t)(K_POLL_TYPE_SEM_AVAILABLE));
#endif
#ifdef K_POLL_TYPE_DATA_AVAILABLE
addConstant<uint32_t>(*this, "K_POLL_TYPE_DATA_AVAILABLE", (uint32_t)(K_POLL_TYPE_DATA_AVAILABLE));
#endif
#ifdef K_POLL_TYPE_MSGQ_DATA_AVAILABLE
addConstant<uint32_t>(*this, "K_POLL_TYPE_MSGQ_DATA_AVAILABLE", (uint32_t)(K_POLL_TYPE_MSGQ_DATA_AVAILABLE));
#endif
#ifdef K_POLL_TYPE_PIPE_DATA_AVAILABLE
addConstant<uint32_t>(*this, "K_POLL_TYPE_PIPE_DATA_AVAILABLE", (uint32_t)(K_POLL_TYPE_PIPE_DATA_AVAILABLE));
#endif
#ifdef K_POLL_STATE_SIGNALED
addConstant<uint32_t>(*this, "K_POLL_STATE_SIGNALED", (uint32_t)(K_POLL_STATE_SIGNALED));
#endif
#ifdef K_POLL_STATE_SEM_AVAILABLE
addConstant<uint32_t>(*this, "K_POLL_STATE_SEM_AVAILABLE", (uint32_t)(K_POLL_STATE_SEM_AVAILABLE));
#endif
#ifdef K_POLL_STATE_DATA_AVAILABLE
addConstant<uint32_t>(*this, "K_POLL_STATE_DATA_AVAILABLE", (uint32_t)(K_POLL_STATE_DATA_AVAILABLE));
#endif
#ifdef K_POLL_STATE_MSGQ_DATA_AVAILABLE
addConstant<uint32_t>(*this, "K_POLL_STATE_MSGQ_DATA_AVAILABLE", (uint32_t)(K_POLL_STATE_MSGQ_DATA_AVAILABLE));
#endif
#ifdef K_POLL_STATE_PIPE_DATA_AVAILABLE
addConstant<uint32_t>(*this, "K_POLL_STATE_PIPE_DATA_AVAILABLE", (uint32_t)(K_POLL_STATE_PIPE_DATA_AVAILABLE));
#endif
#ifdef K_POLL_STATE_CANCELLED
addConstant<uint32_t>(*this, "K_POLL_STATE_CANCELLED", (uint32_t)(K_POLL_STATE_CANCELLED));
#endif
#ifdef GPIO_INPUT
addConstant<uint32_t>(*this, "GPIO_INPUT", (uint32_t)(GPIO_INPUT));
#endif
#ifdef GPIO_OUTPUT
addConstant<uint32_t>(*this, "GPIO_OUTPUT", (uint32_t)(GPIO_OUTPUT));
#endif
#ifdef GPIO_OUTPUT_INIT_LOW
addConstant<uint32_t>(*this, "GPIO_OUTPUT_INIT_LOW", (uint32_t)(GPIO_OUTPUT_INIT_LOW));
#endif
#ifdef GPIO_OUTPUT_INIT_HIGH
addConstant<uint32_t>(*this, "GPIO_OUTPUT_INIT_HIGH", (uint32_t)(GPIO_OUTPUT_INIT_HIGH));
#endif
#ifdef GPIO_OUTPUT_INIT_LOGICAL
addConstant<uint32_t>(*this, "GPIO_OUTPUT_INIT_LOGICAL", (uint32_t)(GPIO_OUTPUT_INIT_LOGICAL));
#endif
#ifdef GPIO_OUTPUT_LOW
addConstant<uint32_t>(*this, "GPIO_OUTPUT_LOW", (uint32_t)(GPIO_OUTPUT_LOW));
#endif
#ifdef GPIO_OUTPUT_HIGH
addConstant<uint32_t>(*this, "GPIO_OUTPUT_HIGH", (uint32_t)(GPIO_OUTPUT_HIGH));
#endif
#ifdef GPIO_OUTPUT_INACTIVE
addConstant<uint32_t>(*this, "GPIO_OUTPUT_INACTIVE", (uint32_t)(GPIO_OUTPUT_INACTIVE));
#endif
#ifdef GPIO_OUTPUT_ACTIVE
addConstant<uint32_t>(*this, "GPIO_OUTPUT_ACTIVE", (uint32_t)(GPIO_OUTPUT_ACTIVE));
#endif
#ifdef GPIO_INT_DISABLE
addConstant<uint32_t>(*this, "GPIO_INT_DISABLE", (uint32_t)(GPIO_INT_DISABLE));
#endif
#ifdef GPIO_INT_ENABLE
addConstant<uint32_t>(*this, "GPIO_INT_ENABLE", (uint32_t)(GPIO_INT_ENABLE));
#endif
#ifdef GPIO_INT_LEVELS_LOGICAL
addConstant<uint32_t>(*this, "GPIO_INT_LEVELS_LOGICAL", (uint32_t)(GPIO_INT_LEVELS_LOGICAL));
#endif
#ifdef GPIO_INT_EDGE
addConstant<uint32_t>(*this, "GPIO_INT_EDGE", (uint32_t)(GPIO_INT_EDGE));
#endif
#ifdef GPIO_INT_LOW_0
addConstant<uint32_t>(*this, "GPIO_INT_LOW_0", (uint32_t)(GPIO_INT_LOW_0));
#endif
#ifdef GPIO_INT_HIGH_1
addConstant<uint32_t>(*this, "GPIO_INT_HIGH_1", (uint32_t)(GPIO_INT_HIGH_1));
#endif
#ifdef GPIO_INT_ENABLE_DISABLE_ONLY
addConstant<uint32_t>(*this, "GPIO_INT_ENABLE_DISABLE_ONLY", (uint32_t)(GPIO_INT_ENABLE_DISABLE_ONLY));
#endif
#ifdef GPIO_INT_MASK
addConstant<uint32_t>(*this, "GPIO_INT_MASK", (uint32_t)(GPIO_INT_MASK));
#endif
#ifdef GPIO_INT_EDGE_RISING
addConstant<uint32_t>(*this, "GPIO_INT_EDGE_RISING", (uint32_t)(GPIO_INT_EDGE_RISING));
#endif
#ifdef GPIO_INT_EDGE_FALLING
addConstant<uint32_t>(*this, "GPIO_INT_EDGE_FALLING", (uint32_t)(GPIO_INT_EDGE_FALLING));
#endif
#ifdef GPIO_INT_EDGE_BOTH
addConstant<uint32_t>(*this, "GPIO_INT_EDGE_BOTH", (uint32_t)(GPIO_INT_EDGE_BOTH));
#endif
#ifdef GPIO_INT_LEVEL_LOW
addConstant<uint32_t>(*this, "GPIO_INT_LEVEL_LOW", (uint32_t)(GPIO_INT_LEVEL_LOW));
#endif
#ifdef GPIO_INT_LEVEL_HIGH
addConstant<uint32_t>(*this, "GPIO_INT_LEVEL_HIGH", (uint32_t)(GPIO_INT_LEVEL_HIGH));
#endif
#ifdef GPIO_INT_EDGE_TO_INACTIVE
addConstant<uint32_t>(*this, "GPIO_INT_EDGE_TO_INACTIVE", (uint32_t)(GPIO_INT_EDGE_TO_INACTIVE));
#endif
#ifdef GPIO_INT_EDGE_TO_ACTIVE
addConstant<uint32_t>(*this, "GPIO_INT_EDGE_TO_ACTIVE", (uint32_t)(GPIO_INT_EDGE_TO_ACTIVE));
#endif
#ifdef GPIO_INT_LEVEL_INACTIVE
addConstant<uint32_t>(*this, "GPIO_INT_LEVEL_INACTIVE", (uint32_t)(GPIO_INT_LEVEL_INACTIVE));
#endif
#ifdef GPIO_INT_LEVEL_ACTIVE
addConstant<uint32_t>(*this, "GPIO_INT_LEVEL_ACTIVE", (uint32_t)(GPIO_INT_LEVEL_ACTIVE));
#endif
#ifdef GPIO_DIR_MASK
addConstant<uint32_t>(*this, "GPIO_DIR_MASK", (uint32_t)(GPIO_DIR_MASK));
#endif
#ifdef GPIO_MAX_PINS_PER_PORT
addConstant<uint32_t>(*this, "GPIO_MAX_PINS_PER_PORT", (uint32_t)(GPIO_MAX_PINS_PER_PORT));
#endif
